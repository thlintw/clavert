## boards/shields/clavert/Kconfig.defconfig
```kconfig
# Copyright (c) 2021 The ZMK Contributors
# SPDX-License-Identifier: MIT

if SHIELD_CLAVERT_LEFT

config ZMK_KEYBOARD_NAME
	default "Clavert"

config ZMK_SPLIT_ROLE_CENTRAL
	default y

endif

if SHIELD_CLAVERT_LEFT || SHIELD_CLAVERT_RIGHT

config ZMK_SPLIT
	default y

endif

CONFIG_ZMK_DISPLAY=y
CONFIG_ZMK_PM_SOFT_OFF=y
CONFIG_ZMK_WIDGET_WPM_STATUS=n
```

## boards/shields/clavert_colemak_dh/Kconfig.shield
```kconfig
# Copyright (c) 2021 The ZMK Contributors
# SPDX-License-Identifier: MIT
config SHIELD_CLAVERT_COLEMAK_DH_LEFT
	def_bool $(shields_list_contains,clavert_colemak_dh_left)

config SHIELD_CLAVERT_COLEMAK_DH_RIGHT
	def_bool $(shields_list_contains,clavert_colemak_dh_right)
```

## config/boards/shields/clavert/Kconfig.shield
```kconfig
# Copyright (c) 2021 The ZMK Contributors
# SPDX-License-Identifier: MIT
config SHIELD_CLAVERT_LEFT
	def_bool $(shields_list_contains,clavert_left)

config SHIELD_CLAVERT_RIGHT
	def_bool $(shields_list_contains,clavert_right)
```

## config/boards/shields/clavert_colemak_dh/Kconfig.defconfig
```kconfig
# Copyright (c) 2021 The ZMK Contributors
# SPDX-License-Identifier: MIT

if SHIELD_CLAVERT_COLEMAK_DH_LEFT

config ZMK_KEYBOARD_NAME
	default "ClavertColemakDH"

config ZMK_SPLIT_ROLE_CENTRAL
	default y

endif

if SHIELD_CLAVERT_COLEMAK_DH_LEFT || SHIELD_CLAVERT_COLEMAK_DH_RIGHT

config ZMK_SPLIT
	default y

endif
```

## config/west.yml
```yaml
manifest:
  remotes:
    - name: zmkfirmware
      url-base: https://github.com/zmkfirmware
    - name: m165437
      url-base: https://github.com/M165437
  projects:
    - name: zmk
      remote: zmkfirmware
      revision: main
      import: app/west.yml
    - name: nice-view-gem
      remote: m165437
      revision: main
  self:
    path: config
```
